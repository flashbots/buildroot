## configs/flashbots_tee_x86_64_efi_defconfig
```kconfig
BR2_x86_64=y
BR2_CCACHE=y
BR2_REPRODUCIBLE=y
BR2_TARGET_GENERIC_HOSTNAME="flashbots"
BR2_TARGET_GENERIC_ISSUE="Welcome to a TEE party!"
BR2_INIT_OPENRC=y
BR2_ROOTFS_DEVICE_CREATION_DYNAMIC_EUDEV=y
BR2_ROOTFS_MERGED_USR=y
BR2_TARGET_GENERIC_ROOT_PASSWD="root"
# BR2_TARGET_GENERIC_REMOUNT_ROOTFS_RW is not set
BR2_SYSTEM_DEFAULT_PATH="/bin:/sbin:/usr/bin:/usr/sbin"
BR2_ROOTFS_OVERLAY="board/flashbots-tee/rootfs_overlay"
BR2_ROOTFS_POST_BUILD_SCRIPT="board/flashbots-tee/post-build.sh"
BR2_ROOTFS_POST_IMAGE_SCRIPT="board/flashbots-tee/post-image-efi.sh"
BR2_LINUX_KERNEL=y
BR2_LINUX_KERNEL_USE_CUSTOM_CONFIG=y
BR2_LINUX_KERNEL_CUSTOM_CONFIG_FILE="board/flashbots-tee/linux.config"
BR2_LINUX_KERNEL_NEEDS_HOST_OPENSSL=y
BR2_LINUX_KERNEL_NEEDS_HOST_LIBELF=y
BR2_PACKAGE_STRACE=y
BR2_PACKAGE_E2FSPROGS=y
BR2_PACKAGE_E2FSPROGS_RESIZE2FS=y
BR2_PACKAGE_FUSE_OVERLAYFS=y
BR2_PACKAGE_LINUX_FIRMWARE=y
BR2_PACKAGE_LINUX_FIRMWARE_RTL_8169=y
BR2_PACKAGE_ACPID=y
BR2_PACKAGE_CNI_PLUGINS=y
BR2_PACKAGE_LIBCURL=y
BR2_PACKAGE_LIBCURL_CURL=y
BR2_PACKAGE_CONNMAN=y
BR2_PACKAGE_CONNMAN_NFTABLES=y
BR2_PACKAGE_CONNMAN_WIFI=y
BR2_PACKAGE_CONNMAN_CLIENT=y
BR2_PACKAGE_IPROUTE2=y
BR2_PACKAGE_IPTABLES=y
BR2_PACKAGE_URANDOM_SCRIPTS=y
BR2_PACKAGE_CRUN=y
BR2_PACKAGE_PODMAN=y
BR2_TARGET_ROOTFS_INITRAMFS=y
# BR2_TARGET_ROOTFS_TAR is not set
BR2_TARGET_GRUB2=y
BR2_TARGET_GRUB2_X86_64_EFI=y
BR2_PACKAGE_HOST_DOSFSTOOLS=y
BR2_PACKAGE_HOST_E2FSPROGS=y
BR2_PACKAGE_HOST_GENEXT2FS=y
BR2_PACKAGE_HOST_GENIMAGE=y
BR2_PACKAGE_HOST_MTOOLS=y
```

## package/netavark/Config.in
```kconfig
config BR2_PACKAGE_NETAVARK
	bool "netavark"
	depends on BR2_PACKAGE_HOST_RUSTC_TARGET_ARCH_SUPPORTS
  select BR2_PACKAGE_HOST_RUSTC

	help
	  Container network stack.

	  https://github.com/containers/netavark/
```

## package/passt/Config.in
```kconfig
config BR2_PACKAGE_PASST
	bool "passt"
	help
    passt implements a translation layer between a Layer-2 network interface and
		native Layer-4 sockets (TCP, UDP, ICMP/ICMPv6 echo) on a host. It doesn't
		require any capabilities or privileges, and it can be used as a simple
		replacement for Slirp.

	  https://passt.top/passt
```

## package/podman/Config.in
```kconfig
config BR2_PACKAGE_PODMAN
	bool "podman"
	depends on BR2_PACKAGE_HOST_GO_TARGET_ARCH_SUPPORTS
	depends on BR2_PACKAGE_HOST_GO_TARGET_CGO_LINKING_SUPPORTS
	depends on BR2_TOOLCHAIN_HAS_THREADS
  depends on !BR2_TOOLCHAIN_USES_UCLIBC # runc
	depends on BR2_USE_MMU # util-linux
	select BR2_PACKAGE_UTIL_LINUX_BINARIES
	select BR2_PACKAGE_UTIL_LINUX_PIVOT_ROOT
	select BR2_PACKAGE_UTIL_LINUX_MOUNTPOINT
	select BR2_PACKAGE_UTIL_LINUX_MOUNT
	select BR2_PACKAGE_BRIDGE_UTILS # Required for container networking
  select BR2_PACKAGE_RUNC if !BR2_PACKAGE_CRUN # runtime dependency
	select BR2_PACKAGE_UTIL_LINUX # runtime dependency
	select BR2_PACKAGE_CONMON  # runtime dependency
	select BR2_PACKAGE_NETAVARK # runtime dependency
	select BR2_PACKAGE_CGROUPFS_MOUNT if !BR2_PACKAGE_SYSTEMD # runtime dependency
	select BR2_PACKAGE_CA_CERTIFICATES # Required for the podman pull command via https
	select BR2_PACKAGE_SHADOW # Required for rootless support
  select BR2_PACKAGE_SHADOW_SUBORDINATE_IDS # Required for rootless support
	select BR2_PACKAGE_SLIRP4NETNS # Required for rootless network access

	depends on !BR2_TOOLCHAIN_USES_UCLIBC # no fexecve
	help
	  Simple management tool for pods, containers and images.

	  https://github.com/containers/podman/

comment "podman needs a glibc or musl toolchain w/ threads"
	depends on BR2_PACKAGE_HOST_GO_TARGET_ARCH_SUPPORTS
	depends on BR2_PACKAGE_HOST_GO_TARGET_CGO_LINKING_SUPPORTS
	depends on BR2_USE_MMU
	depends on !BR2_TOOLCHAIN_HAS_THREADS || BR2_TOOLCHAIN_USES_UCLIBC
```
